// Generated by embed_web.py from editor.html.
#pragma once
#include <Arduino.h>
static const char editorHtml[] PROGMEM = R"POV_HTML(<!doctype html>
<html lang="en">
  <head>
    <meta charset="utf-8" />
    <meta name="viewport" content="width=device-width, initial-scale=1" />
    <title>Tiny Lamp studio</title>
    <style>
      :root {
        color-scheme: light;
        --paper: #f7f5ee;
        --ink: #20392f;
        --muted: #657469;
        --line: #d9dfd4;
        --green: #285942;
        --accent: #def1a9;
      }
      * {
        box-sizing: border-box;
      }
      body {
        margin: 0;
        background: var(--paper);
        color: var(--ink);
        font:
          16px system-ui,
          -apple-system,
          BlinkMacSystemFont,
          "Segoe UI",
          sans-serif;
      }
      button,
      input {
        font: inherit;
      }
      button {
        cursor: pointer;
      }
      button:disabled {
        cursor: wait;
        opacity: 0.55;
      }
      button:focus-visible,
      input:focus-visible {
        outline: 3px solid #6f9f42;
        outline-offset: 3px;
      }
      header {
        max-width: 1180px;
        margin: auto;
        padding: 28px 32px;
        display: flex;
        align-items: center;
        justify-content: space-between;
        border-bottom: 1px solid var(--line);
      }
      .brand {
        font-weight: 750;
        letter-spacing: -0.5px;
        display: flex;
        align-items: center;
        gap: 12px;
      }
      .mark {
        display: grid;
        grid-template-columns: repeat(3, 5px);
        gap: 3px;
      }
      .mark i {
        width: 5px;
        height: 5px;
        background: var(--green);
        border-radius: 2px;
      }
      .mark i:nth-child(3n) {
        background: #a6c67f;
      }
      .connection {
        font-size: 13px;
        color: var(--muted);
        display: flex;
        gap: 8px;
        align-items: center;
      }
      .dot {
        width: 7px;
        height: 7px;
        background: #75994f;
        border-radius: 50%;
      }
      main {
        max-width: 1180px;
        margin: auto;
        padding: 42px 32px 60px;
      }
      .intro {
        display: flex;
        justify-content: space-between;
        gap: 20px;
        align-items: end;
        margin-bottom: 30px;
      }
      h1 {
        font-size: clamp(28px, 5vw, 42px);
        font-weight: 650;
        letter-spacing: -1.8px;
        line-height: 1.15;
        margin: 0 0 12px;
      }
      .intro p {
        color: var(--muted);
        max-width: 590px;
        line-height: 1.6;
        margin: 0;
      }
      .tag {
        font-size: 12px;
        border: 1px solid var(--line);
        padding: 8px 12px;
        border-radius: 30px;
        white-space: nowrap;
      }
      .layout {
        display: grid;
        grid-template-columns: minmax(0, 1fr) 280px;
        gap: 24px;
      }
      .card {
        background: #fff;
        border: 1px solid var(--line);
        border-radius: 18px;
        overflow: hidden;
      }
      .workspace-head {
        padding: 22px 24px;
        display: flex;
        justify-content: space-between;
        align-items: center;
        border-bottom: 1px solid #e8ece4;
      }
      .workspace-head strong {
        font-size: 17px;
      }
      .badge {
        font-size: 12px;
        color: var(--muted);
      }
      .controls {
        padding: 22px 24px;
        display: flex;
        gap: 16px;
        flex-wrap: wrap;
        align-items: end;
      }
      label {
        font-size: 13px;
        color: var(--muted);
        display: block;
        margin-bottom: 8px;
      }
      input[type="number"] {
        width: 80px;
        border: 1px solid var(--line);
        border-radius: 9px;
        padding: 10px;
        background: #fff;
        color: var(--ink);
      }
      .button {
        border: 1px solid var(--line);
        background: #fff;
        color: var(--ink);
        border-radius: 9px;
        padding: 11px 14px;
        font-size: 14px;
      }
      .button:hover {
        background: #f1f5eb;
      }
      .controls .spacer {
        flex: 1;
      }
      .palette-area {
        padding: 0 24px 22px;
      }
      .palette-caption {
        display: flex;
        justify-content: space-between;
        align-items: center;
        margin-bottom: 12px;
        font-size: 13px;
        color: var(--muted);
      }
      #palette {
        display: flex;
        gap: 9px;
        flex-wrap: wrap;
      }
      .swatch {
        width: 32px;
        height: 32px;
        border: 1px solid #d9dfd4;
        border-radius: 50%;
        position: relative;
        padding: 0;
      }
      .swatch.selected:after {
        content: "";
        position: absolute;
        inset: -5px;
        border: 2px solid var(--green);
        border-radius: 50%;
      }
      .canvas-wrap {
        background: #eff2e9;
        padding: 24px;
        overflow: auto;
        border-block: 1px solid #e3e8dc;
      }
      .grid-frame {
        width: max-content;
        min-width: 100%;
        display: flex;
        justify-content: center;
      }
      #grid {
        display: grid;
        gap: 4px;
        user-select: none;
        -webkit-user-select: none;
      }
      .cell {
        width: clamp(22px, 3.2vw, 34px);
        height: clamp(22px, 3.2vw, 34px);
        padding: 0;
        border: 1px solid #ffffff20;
        border-radius: 5px;
        touch-action: none;
      }
      .cell:hover {
        outline: 2px solid #70816d;
        outline-offset: 1px;
      }
      .axis {
        display: flex;
        justify-content: center;
        align-items: center;
        font-size: 10px;
        color: #768371;
      }
      .blank {
        width: 23px;
        height: 20px;
      }
      .canvas-footer {
        display: flex;
        justify-content: space-between;
        gap: 10px;
        padding: 16px 24px;
        font-size: 12px;
        color: var(--muted);
      }
      .direction {
        letter-spacing: 1px;
      }
      .side {
        display: flex;
        flex-direction: column;
        gap: 20px;
      }
      .playback {
        padding: 24px;
        background: #20392f;
        color: #fff;
        border-color: #20392f;
      }
      .eyebrow {
        font-size: 11px;
        letter-spacing: 1.8px;
        text-transform: uppercase;
        opacity: 0.65;
      }
      .power-line {
        display: flex;
        align-items: center;
        justify-content: space-between;
        margin: 22px 0 10px;
      }
      .power-line h2 {
        font-size: 23px;
        font-weight: 550;
        margin: 0;
      }
      .switch {
        width: 54px;
        height: 30px;
        border: 0;
        border-radius: 20px;
        background: #6d7d70;
        padding: 4px;
        display: flex;
        align-items: center;
      }
      .switch:before {
        content: "";
        width: 22px;
        height: 22px;
        background: white;
        border-radius: 50%;
        transition: transform 0.15s;
      }
      .switch[aria-checked="true"] {
        background: #c8e692;
      }
      .switch[aria-checked="true"]:before {
        transform: translateX(24px);
      }
      .playback p {
        font-size: 13px;
        line-height: 1.6;
        color: #c2d1c7;
        margin-bottom: 0;
      }
      .settings {
        padding: 24px;
      }
      .settings h2 {
        font-size: 16px;
        margin: 0 0 24px;
      }
      .setting {
        margin-bottom: 22px;
      }
      .setting-line {
        display: flex;
        justify-content: space-between;
        align-items: center;
        margin-bottom: 10px;
      }
      .setting-line label {
        margin: 0;
      }
      .setting-line output {
        font-size: 13px;
        font-variant-numeric: tabular-nums;
      }
      input[type="range"] {
        width: 100%;
        accent-color: var(--green);
        margin: 0;
      }
      .setting small {
        display: block;
        color: var(--muted);
        font-size: 12px;
        line-height: 1.5;
        margin-top: 8px;
      }
      .send {
        display: block;
        width: 100%;
        background: var(--green);
        color: #fff;
        border: 0;
        border-radius: 10px;
        padding: 15px;
        font-weight: 600;
      }
      .send:hover {
        background: #1f4735;
      }
      .save-note {
        font-size: 12px;
        text-align: center;
        color: var(--muted);
        line-height: 1.5;
        margin: 12px 0 0;
      }
      #message {
        font-size: 13px;
        line-height: 1.6;
        margin: 15px 0 0;
        min-height: 21px;
      }
      #message.error {
        color: #a53f2e;
      }
      .how {
        margin-top: 25px;
        font-size: 13px;
        line-height: 1.7;
        color: var(--muted);
      }
      .how strong {
        color: var(--ink);
      }
      .how a {
        color: var(--green);
      }
      @media (max-width: 800px) {
        header {
          padding: 20px;
        }
        main {
          padding: 30px 16px;
        }
        .layout {
          grid-template-columns: 1fr;
        }
        .side {
          display: grid;
          grid-template-columns: 1fr 1fr;
          align-items: start;
        }
        .intro .tag {
          display: none;
        }
        .canvas-wrap {
          padding: 20px 12px;
        }
        .controls {
          gap: 12px;
        }
        .workspace-head,
        .controls,
        .palette-area {
          padding-left: 18px;
          padding-right: 18px;
        }
      }
      @media (max-width: 480px) {
        .side {
          grid-template-columns: 1fr;
        }
        .controls .spacer {
          display: none;
        }
        .controls .button {
          padding: 11px 10px;
        }
        .canvas-footer {
          padding: 15px;
          font-size: 11px;
        }
        .connection {
          font-size: 11px;
        }
        .intro p {
          font-size: 14px;
        }
      }
      [hidden] {
        display: none !important;
      }
      .mode-bar {
        display: flex;
        gap: 6px;
        padding: 5px;
        width: max-content;
        background: #e8ede0;
        border-radius: 12px;
        margin-bottom: 22px;
      }
      .mode-button {
        border: 0;
        border-radius: 9px;
        padding: 12px 22px;
        background: transparent;
        color: var(--muted);
        font-weight: 600;
      }
      .mode-button[aria-pressed="true"] {
        background: #fff;
        color: var(--ink);
        box-shadow: 0 2px 5px #20392f0d;
      }
      .lamp-preview {
        padding: 65px 25px 30px;
        background: radial-gradient(ellipse at center, #fff3d8, #f2f2e8 70%);
        text-align: center;
      }
      #lampStrip {
        display: flex;
        justify-content: center;
        gap: 7px;
        min-height: 80px;
        align-items: center;
        flex-wrap: wrap;
      }
      .lamp-led {
        width: 20px;
        height: 45px;
        border-radius: 12px;
        box-shadow: 0 0 24px currentColor;
        border: 1px solid #ffffff80;
      }
      .lamp-preview p {
        font-size: 13px;
        color: var(--muted);
        margin: 25px 0 0;
      }
      .lamp-content {
        padding: 25px;
      }
      #presets {
        display: grid;
        grid-template-columns: repeat(3, 1fr);
        gap: 10px;
        margin-bottom: 30px;
      }
      .preset {
        background: #fff;
        border: 1px solid var(--line);
        padding: 15px 12px;
        text-align: left;
        border-radius: 12px;
        color: var(--ink);
      }
      .preset[aria-pressed="true"] {
        border-color: var(--green);
        background: #f0f6e7;
        box-shadow: inset 0 0 0 1px var(--green);
      }
      .preset strong {
        display: block;
        font-size: 14px;
        margin-bottom: 6px;
      }
      .preset small {
        color: var(--muted);
        font-size: 11px;
      }
      .lamp-color-row {
        display: flex;
        gap: 24px;
        align-items: center;
        flex-wrap: wrap;
      }
      input[type="color"] {
        width: 80px;
        height: 43px;
        padding: 4px;
        border: 1px solid var(--line);
        border-radius: 9px;
        background: #fff;
        cursor: pointer;
      }
      #lampHex {
        color: var(--muted);
        font-size: 13px;
        margin-top: 20px;
        font-variant-numeric: tabular-nums;
      }
      .lamp-hint {
        color: var(--muted);
        font-size: 12px;
        line-height: 1.6;
        margin-top: 25px;
      }
      @media (max-width: 480px) {
        #presets {
          grid-template-columns: repeat(2, 1fr);
        }
        .lamp-led {
          width: 13px;
          height: 35px;
        }
        #lampStrip {
          gap: 5px;
        }
      }
    </style>
  </head>
  <body>
    <header>
      <div class="brand">
        <span class="mark" aria-hidden="true"
          ><i></i><i></i><i></i><i></i><i></i><i></i><i></i><i></i><i></i></span
        >Tiny Lamp
      </div>
      <div class="connection">
        <span class="dot" id="connectionDot"></span
        ><span id="connection">Connecting to lamp</span>
      </div>
    </header>
    <main>
      <div class="intro">
        <div>
          <h1>Your light, your way.</h1>
          <p id="introDescription">
            Paint your picture one pixel at a time. The LED strip plays each
            column in order as you sweep it through the air.
          </p>
        </div>
        <span class="tag" id="modeTag">Persistence of vision</span>
      </div>
      <div class="mode-bar" role="group" aria-label="Light mode">
        <button class="mode-button" id="povMode" aria-pressed="true">
          POV picture
        </button>
        <button class="mode-button" id="lampMode" aria-pressed="false">
          Lamp
        </button>
      </div>
      <div class="layout">
        <section class="card" id="povPanel" aria-label="Picture editor">
          <div class="workspace-head">
            <strong>Your picture</strong
            ><span class="badge" id="saved">Loading picture…</span>
          </div>
          <div class="controls">
            <div>
              <label for="ledCount">LEDs / height</label
              ><input id="ledCount" type="number" min="1" max="32" value="11" />
            </div>
            <div>
              <label for="columns">Columns / width</label
              ><input id="columns" type="number" min="1" max="64" value="10" />
            </div>
            <button class="button" id="addColumn">+ Column</button
            ><span class="spacer"></span
            ><button class="button" id="clear">Clear</button>
          </div>
          <div class="palette-area">
            <div class="palette-caption">
              <span>Choose a brush</span><span id="brushName">Coral</span>
            </div>
            <div id="palette" role="group" aria-label="Brush colors"></div>
          </div>
          <div class="canvas-wrap">
            <div class="grid-frame">
              <div id="grid" role="group" aria-label="Picture pixels"></div>
            </div>
          </div>
          <div class="canvas-footer">
            <span id="dimensions">11 LEDs × 10 columns</span
            ><span class="direction">PLAYBACK →</span>
          </div>
        </section>
        <section class="card" id="lampPanel" aria-label="Lamp settings" hidden>
          <div class="workspace-head">
            <strong>Your lamp</strong
            ><span class="badge" id="lampSaved">Loading settings…</span>
          </div>
          <div class="lamp-preview">
            <div id="lampStrip" aria-label="Lamp color preview"></div>
            <p id="lampDescription">A steady color across every LED.</p>
          </div>
          <div class="lamp-content">
            <label>Choose a setting</label>
            <div id="presets" role="group" aria-label="Lamp presets"></div>
            <div class="lamp-color-row">
              <div>
                <label for="lampColor">Your own color</label
                ><input id="lampColor" type="color" value="#ffb347" />
              </div>
              <div>
                <label for="lampLedCount">LED count</label
                ><input
                  id="lampLedCount"
                  type="number"
                  min="1"
                  max="32"
                  value="15"
                />
              </div>
              <span id="lampHex">#ffb347</span>
            </div>
            <p class="lamp-hint">
              Choosing a color selects Solid color. Click Apply lamp to save and
              start it.
            </p>
          </div>
        </section>
        <aside class="side">
          <section class="card playback">
            <div class="eyebrow">Lamp playback</div>
            <div class="power-line">
              <h2 id="powerLabel">Off</h2>
              <button
                class="switch"
                id="power"
                role="switch"
                aria-label="Lamp power"
                aria-checked="false"
                disabled
              ></button>
            </div>
            <p>The breadboard button switches playback on and off too.</p>
          </section>
          <section class="card settings">
            <div id="povSettings">
              <h2>Sweep settings</h2>
              <div class="setting">
                <div class="setting-line">
                  <label for="columnMs">Column duration</label
                  ><output id="timingValue">5 ms</output>
                </div>
                <input
                  id="columnMs"
                  type="range"
                  min="2"
                  max="100"
                  value="5"
                /><small>Slower sweep? Give each column more time.</small>
              </div>
              <div class="setting">
                <div class="setting-line">
                  <label for="brightness">Brightness</label
                  ><output id="brightnessValue">20%</output>
                </div>
                <input
                  id="brightness"
                  type="range"
                  min="1"
                  max="40"
                  value="20"
                /><small id="sweepSummary">One picture takes 50 ms.</small>
              </div>
              <button class="send" id="send" disabled>
                Send picture to lamp
              </button>
              <p class="save-note">
                Saves your picture and starts playback.<br />The lamp starts off
                after a restart.
              </p>
            </div>
            <div id="lampSettings" hidden>
              <h2>Lamp brightness</h2>
              <div class="setting">
                <div class="setting-line">
                  <label for="lampBrightness">Brightness</label
                  ><output id="lampBrightnessValue">20%</output>
                </div>
                <input
                  id="lampBrightness"
                  type="range"
                  min="1"
                  max="40"
                  value="20"
                /><small>Keep it low for a soft glow.</small>
              </div>
              <button class="send" id="applyLamp" disabled>Apply lamp</button>
              <p class="save-note">
                Saves this setting and turns the lamp on.<br />The lamp starts
                off after a restart.
              </p>
            </div>
            <p id="message" role="status" aria-live="polite"></p>
          </section>
        </aside>
      </div>
      <p class="how" id="povHelp">
        <strong>First sweep?</strong> Paint a few bright pixels, send the
        picture, then move the strip sideways. Adjust column duration to match
        your movement. LED 1 is the first LED connected to the data wire, shown
        at the top of this grid. <a href="/">Wi-Fi status</a>
      </p>
    </main>
    <script>
      "use strict";
      const colors = [
        ["Coral", "ff5d5d"],
        ["Orange", "ffb347"],
        ["Yellow", "ffe066"],
        ["Green", "75d58a"],
        ["Mint", "55d6be"],
        ["Sky", "5ac8fa"],
        ["Blue", "5982ff"],
        ["Purple", "a68aff"],
        ["Pink", "ff8dc7"],
        ["White", "ffffff"],
        ["Off / erase", "000000"],
      ];
      const presets = [
        [
          "Solid color",
          "Make it yours",
          "ffb347",
          "A steady color across every LED.",
        ],
        [
          "Fireplace",
          "Flickering embers",
          "ff7a20",
          "Warm embers flicker gently along the strip.",
        ],
        [
          "Snow",
          "Cool little sparkles",
          "a6d8ff",
          "Soft white sparkles over a cool blue glow.",
        ],
        [
          "Cozy",
          "A slow amber breath",
          "ff8e38",
          "A soft amber glow that slowly breathes.",
        ],
        [
          "Warm",
          "Steady golden light",
          "ffaa5f",
          "Steady, warm golden light for everyday use.",
        ],
      ];
      let lamp = { preset: 0, ledCount: 15, brightness: 20, color: "ffb347" };
      let mode = "pov",
        lampDirty = false,
        lampEditVersion = 0;
      const byId = (id) => document.getElementById(id);
      let picture = {
        ledCount: 11,
        columns: 10,
        columnMs: 5,
        brightness: 20,
        pixels: Array(110).fill("000000"),
      };
      let brush = colors[0][1],
        on = false,
        ready = false,
        dirty = false,
        busy = false,
        painting = false,
        loaded = false,
        editVersion = 0;
      function message(text, error = false) {
        byId("message").textContent = text;
        byId("message").classList.toggle("error", error);
      }
      function edited() {
        dirty = true;
        editVersion++;
        byId("saved").textContent = "Unsaved edits";
      }
      function lampEdited() {
        lampDirty = true;
        lampEditVersion++;
        byId("lampSaved").textContent = "Unsaved edits";
        renderLamp();
      }
      function renderLamp() {
        byId("presets").replaceChildren();
        presets.forEach(([name, description], index) => {
          const button = document.createElement("button");
          button.className = "preset";
          button.setAttribute("aria-pressed", String(lamp.preset === index));
          button.setAttribute("aria-label", name);
          const title = document.createElement("strong");
          title.textContent = name;
          const detail = document.createElement("small");
          detail.textContent = description;
          button.append(title, detail);
          button.onclick = () => {
            lamp.preset = index;
            lampEdited();
          };
          byId("presets").append(button);
        });
        const color =
          "#" + (lamp.preset === 0 ? lamp.color : presets[lamp.preset][2]);
        byId("lampStrip").replaceChildren();
        for (let i = 0; i < lamp.ledCount; i++) {
          const led = document.createElement("span");
          led.className = "lamp-led";
          led.style.backgroundColor = color;
          led.style.color = color;
          byId("lampStrip").append(led);
        }
        byId("lampDescription").textContent = presets[lamp.preset][3];
        byId("lampColor").value = "#" + lamp.color;
        byId("lampLedCount").value = lamp.ledCount;
        byId("lampHex").textContent = "#" + lamp.color;
        byId("lampBrightness").value = lamp.brightness;
        byId("lampBrightnessValue").textContent = lamp.brightness + "%";
      }
      function renderMode() {
        const isLamp = mode === "lamp";
        byId("povPanel").hidden = isLamp;
        byId("lampPanel").hidden = !isLamp;
        byId("povSettings").hidden = isLamp;
        byId("lampSettings").hidden = !isLamp;
        byId("povHelp").hidden = isLamp;
        byId("povMode").setAttribute("aria-pressed", String(!isLamp));
        byId("lampMode").setAttribute("aria-pressed", String(isLamp));
        byId("modeTag").textContent = isLamp
          ? "Everyday light"
          : "Persistence of vision";
        byId("introDescription").textContent = isLamp
          ? "Choose a steady color or a gentle animation. No movement needed. Just a little light, the way you like it."
          : "Paint your picture one pixel at a time. The LED strip plays each column in order as you sweep it through the air.";
      }
      byId("lampColor").oninput = () => {
        lamp.color = byId("lampColor").value.slice(1);
        lamp.preset = 0;
        lampEdited();
      };
      byId("lampBrightness").oninput = () => {
        lamp.brightness = Number(byId("lampBrightness").value);
        lampEdited();
      };
      byId("lampLedCount").onchange = () => {
        const count = Number(byId("lampLedCount").value);
        if (!Number.isInteger(count) || count < 1 || count > 32) {
          byId("lampLedCount").value = lamp.ledCount;
          return;
        }
        lamp.ledCount = count;
        lampEdited();
      };
      async function selectMode(nextMode) {
        if (mode === nextMode || !loaded || !ready || busy) return;
        busy = true;
        controls();
        try {
          powerState(await api("/api/mode", nextMode));
          message(
            nextMode === "lamp"
              ? "Lamp mode selected. Apply your settings when ready."
              : "POV mode selected. Your picture is still here.",
          );
        } catch (error) {
          message(error.message, true);
        } finally {
          busy = false;
          controls();
        }
      }
      byId("povMode").onclick = () => selectMode("pov");
      byId("lampMode").onclick = () => selectMode("lamp");
      byId("applyLamp").onclick = async () => {
        busy = true;
        controls();
        message("Saving lamp settings…");
        const version = lampEditVersion;
        const body = `${lamp.preset},${lamp.ledCount},${lamp.brightness}\n${lamp.color}`;
        try {
          powerState(await api("/api/lamp", body));
          if (version === lampEditVersion) {
            lampDirty = false;
            byId("lampSaved").textContent = "Saved on lamp";
          }
          message(
            version === lampEditVersion
              ? "Lamp setting saved and switched on."
              : "Saved the sent settings. Newer edits have not been applied.",
          );
        } catch (error) {
          message(error.message, true);
        } finally {
          busy = false;
          controls();
        }
      };
      function renderPalette() {
        byId("palette").replaceChildren();
        for (const [name, color] of colors) {
          const button = document.createElement("button");
          button.className = "swatch" + (brush === color ? " selected" : "");
          button.style.backgroundColor = "#" + color;
          button.title = name;
          button.setAttribute("aria-label", name);
          button.setAttribute("aria-pressed", String(brush === color));
          button.onclick = () => {
            brush = color;
            byId("brushName").textContent = name;
            renderPalette();
          };
          byId("palette").append(button);
        }
      }
      function summaries() {
        byId("dimensions").textContent =
          `${picture.ledCount} LEDs × ${picture.columns} columns`;
        byId("timingValue").textContent = `${picture.columnMs} ms`;
        byId("brightnessValue").textContent = `${picture.brightness}%`;
        byId("sweepSummary").textContent =
          `One picture takes ${picture.columns * picture.columnMs} ms.`;
      }
      function renderGrid() {
        const grid = byId("grid");
        grid.replaceChildren();
        grid.style.gridTemplateColumns = `23px repeat(${picture.columns}, auto)`;
        const corner = document.createElement("span");
        corner.className = "blank";
        grid.append(corner);
        for (let column = 0; column < picture.columns; column++) {
          const label = document.createElement("span");
          label.className = "axis";
          label.textContent = column + 1;
          grid.append(label);
        }
        for (let row = 0; row < picture.ledCount; row++) {
          const label = document.createElement("span");
          label.className = "axis";
          label.textContent = row + 1;
          grid.append(label);
          for (let column = 0; column < picture.columns; column++) {
            const index = column * picture.ledCount + row;
            const cell = document.createElement("button");
            cell.className = "cell";
            cell.dataset.pixel = index;
            cell.style.backgroundColor = "#" + picture.pixels[index];
            cell.setAttribute(
              "aria-label",
              `LED ${row + 1}, column ${column + 1}, #${picture.pixels[index]}`,
            );
            cell.addEventListener("click", () => paint(cell));
            grid.append(cell);
          }
        }
        summaries();
      }
      function paint(cell) {
        if (!cell || !cell.classList.contains("cell")) return;
        const index = Number(cell.dataset.pixel);
        if (picture.pixels[index] === brush) return;
        picture.pixels[index] = brush;
        cell.style.backgroundColor = "#" + brush;
        const row = (index % picture.ledCount) + 1,
          column = Math.floor(index / picture.ledCount) + 1;
        cell.setAttribute(
          "aria-label",
          `LED ${row}, column ${column}, #${brush}`,
        );
        edited();
      }
      byId("grid").addEventListener("pointerdown", (event) => {
        if (event.button !== 0) return;
        const cell = event.target.closest(".cell");
        if (!cell) return;
        painting = true;
        paint(cell);
      });
      document.addEventListener("pointermove", (event) => {
        if (painting)
          paint(document.elementFromPoint(event.clientX, event.clientY));
      });
      document.addEventListener("pointerup", () => (painting = false));
      document.addEventListener("pointercancel", () => (painting = false));
      function resize(height, width) {
        const next = Array(height * width).fill("000000");
        for (
          let column = 0;
          column < Math.min(width, picture.columns);
          column++
        )
          for (let row = 0; row < Math.min(height, picture.ledCount); row++)
            next[column * height + row] =
              picture.pixels[column * picture.ledCount + row];
        picture.pixels = next;
        picture.ledCount = height;
        picture.columns = width;
        byId("ledCount").value = height;
        byId("columns").value = width;
        edited();
        renderGrid();
      }
      function requestResize(height, width) {
        if (
          (height < picture.ledCount || width < picture.columns) &&
          !window.confirm(
            "Reducing the size removes pixels outside the new grid. Continue?",
          )
        ) {
          byId("ledCount").value = picture.ledCount;
          byId("columns").value = picture.columns;
          return;
        }
        resize(height, width);
      }
      byId("ledCount").onchange = () => {
        const value = Number(byId("ledCount").value);
        if (!Number.isInteger(value) || value < 1 || value > 32) {
          byId("ledCount").value = picture.ledCount;
          return;
        }
        requestResize(value, picture.columns);
      };
      byId("columns").onchange = () => {
        const value = Number(byId("columns").value);
        if (!Number.isInteger(value) || value < 1 || value > 64) {
          byId("columns").value = picture.columns;
          return;
        }
        requestResize(picture.ledCount, value);
      };
      byId("addColumn").onclick = () => {
        if (picture.columns >= 64) {
          message("This test supports up to 64 columns.");
          return;
        }
        resize(picture.ledCount, picture.columns + 1);
      };
      byId("clear").onclick = () => {
        if (!window.confirm("Clear every pixel in this picture?")) return;
        picture.pixels.fill("000000");
        edited();
        renderGrid();
      };
      for (const id of ["columnMs", "brightness"])
        byId(id).oninput = () => {
          picture[id] = Number(byId(id).value);
          edited();
          summaries();
        };
      async function api(path, body) {
        const options = {
          cache: "no-store",
          signal: AbortSignal.timeout(10000),
        };
        if (body !== undefined) {
          options.method = "POST";
          options.headers = { "Content-Type": "text/plain" };
          options.body = body;
        }
        const response = await fetch(path, options);
        if (!response.ok) throw new Error(await response.text());
        return response.json();
      }
      function controls() {
        byId("send").disabled = !loaded || !ready || busy;
        byId("power").disabled = !loaded || !ready || busy;
        for (const id of ["applyLamp", "povMode", "lampMode"])
          byId(id).disabled = !loaded || !ready || busy;
      }
      function powerState(state) {
        on = state.on;
        mode = state.mode || "pov";
        renderMode();
        ready = state.ready;
        byId("power").setAttribute("aria-checked", String(on));
        byId("powerLabel").textContent = on
          ? mode === "lamp"
            ? "On"
            : "Playing"
          : "Off";
        byId("connection").textContent = ready
          ? "Connected to lamp"
          : "LED output unavailable";
        byId("connectionDot").style.backgroundColor = ready
          ? "#75994f"
          : "#b86e45";
        controls();
      }
      byId("send").onclick = async () => {
        busy = true;
        controls();
        message("Sending picture…");
        const version = editVersion;
        const body = `${picture.ledCount},${picture.columns},${picture.columnMs},${picture.brightness}\n${picture.pixels.join("")}`;
        try {
          powerState(await api("/api/pattern", body));
          if (version === editVersion) {
            dirty = false;
            byId("saved").textContent = "Saved on lamp";
          }
          message(
            version === editVersion
              ? "Saved. Sweep the LEDs to see your picture."
              : "Saved the sent picture. Your newer edits have not been sent.",
          );
        } catch (error) {
          message(error.message, true);
        } finally {
          busy = false;
          controls();
        }
      };
      byId("power").onclick = async () => {
        busy = true;
        controls();
        try {
          powerState(await api("/api/power", on ? "off" : "on"));
          message(on ? "Light switched on." : "Light switched off.");
        } catch (error) {
          message(error.message, true);
        } finally {
          busy = false;
          controls();
        }
      };
      async function load() {
        try {
          const state = await api("/api/pattern");
          if (!dirty) {
            picture = {
              ledCount: state.ledCount,
              columns: state.columns,
              columnMs: state.columnMs,
              brightness: state.brightness,
              pixels: state.pixels.match(/.{6}/g) || [],
            };
            for (const id of ["ledCount", "columns", "columnMs", "brightness"])
              byId(id).value = picture[id];
            renderGrid();
            byId("saved").textContent = "Saved on lamp";
          }
          if (!lampDirty) {
            lamp = state.lamp || { ...lamp, ledCount: state.ledCount };
            renderLamp();
            byId("lampSaved").textContent = "Saved on lamp";
          }
          loaded = true;
          powerState(state);
          if (!ready)
            message("LED output could not start. Restart the board.", true);
        } catch (error) {
          byId("saved").textContent = dirty
            ? "Unsaved edits"
            : "Could not load picture";
          message(
            "Could not reach the lamp. Check your Wi-Fi and reload this page.",
            true,
          );
          byId("connection").textContent = "Lamp unreachable";
          byId("connectionDot").style.backgroundColor = "#b86e45";
        }
      }
      async function poll() {
        if (document.hidden || busy || !loaded) return;
        try {
          powerState(await api("/api/power"));
        } catch (error) {
          ready = false;
          controls();
          byId("connection").textContent = "Lamp unreachable";
          byId("connectionDot").style.backgroundColor = "#b86e45";
        }
      }
      window.addEventListener("beforeunload", (event) => {
        if (dirty || lampDirty) {
          event.preventDefault();
          event.returnValue = "";
        }
      });
      renderPalette();
      renderGrid();
      renderLamp();
      renderMode();
      load();
      setInterval(poll, 2000);
    </script>
  </body>
</html>
)POV_HTML";
